## conf/layer.conf
```bitbake
# We have a conf and classes directory, add to BBPATH
BBPATH .= ":${LAYERDIR}"

# We have recipes-* directories, add to BBFILES
BBFILES += "${LAYERDIR}/recipes-*/*/*.bb \
	${LAYERDIR}/recipes-*/*/*.bbappend"

BBFILE_COLLECTIONS += "raspi2-ledblink"
BBFILE_PATTERN_raspi2-ledblink = "^${LAYERDIR}/"
BBFILE_PRIORITY_raspi2-ledblink = "6"
LAYERDEPENDS_layername = "raspberrypi"
```
